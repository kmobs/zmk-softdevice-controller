## Kconfig
```kconfig
rsource "src/sdc/Kconfig"

# Three-tier subrating: ACTIVE (typing) -> IDLE (~30s) -> DORMANT (+5min)
# Only split central makes subrate requests; peripherals respond to host

if BT_SUBRATING && ZMK_SPLIT_ROLE_CENTRAL

config ZMK_BLE_SUBRATE_TIMEOUT
	int "Supervision timeout (10ms units)"
	default 800
	range 10 3200

# ACTIVE tier
config ZMK_BLE_SUBRATE_ACTIVE_MIN
	int "Active subrate factor minimum"
	default 1
	range 1 500

config ZMK_BLE_SUBRATE_ACTIVE_MAX
	int "Active subrate factor maximum"
	default 2
	range 1 500

config ZMK_BLE_SUBRATE_ACTIVE_CN
	int "Active continuation number"
	default 1
	range 0 499

# IDLE tier
config ZMK_BLE_SUBRATE_IDLE_MIN
	int "Idle subrate factor minimum"
	default 1
	range 1 500

config ZMK_BLE_SUBRATE_IDLE_MAX
	int "Idle subrate factor maximum"
	default 8
	range 1 500

config ZMK_BLE_SUBRATE_IDLE_CN
	int "Idle continuation number"
	default 7
	range 0 499

config ZMK_BLE_SUBRATE_IDLE_MAX_LATENCY
	int "Idle maximum peripheral latency"
	default 15
	range 0 499

# DORMANT tier
config ZMK_BLE_SUBRATE_DORMANT_DELAY
	int "Milliseconds before dormant tier"
	default 300000
	range 10000 3600000

config ZMK_BLE_SUBRATE_DORMANT_MIN
	int "Dormant subrate factor minimum"
	default 1
	range 1 500

config ZMK_BLE_SUBRATE_DORMANT_MAX
	int "Dormant subrate factor maximum"
	default 25
	range 1 500

config ZMK_BLE_SUBRATE_DORMANT_CN
	int "Dormant continuation number"
	default 24
	range 0 499

config ZMK_BLE_SUBRATE_DORMANT_MAX_LATENCY
	int "Dormant maximum peripheral latency"
	default 15
	range 0 499

endif # BT_SUBRATING && ZMK_SPLIT_ROLE_CENTRAL
```
